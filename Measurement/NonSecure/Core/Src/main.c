/* USER CODE BEGIN Header */
/**
  ******************************************************************************
  * @file           : main.c
  * @brief          : Main program body
  ******************************************************************************
  * @attention
  *
  * Copyright (c) 2022 STMicroelectronics.
  * All rights reserved.
  *
  * This software is licensed under terms that can be found in the LICENSE file
  * in the root directory of this software component.
  * If no LICENSE file comes with this software, it is provided AS-IS.
  *
  ******************************************************************************
  */
/* USER CODE END Header */
/* Includes ------------------------------------------------------------------*/
#include "main.h"

/* Private includes ----------------------------------------------------------*/
/* USER CODE BEGIN Includes */
#include "application.h"
#include <string.h>
#include "gpio.h"
#include "secure_nsc.h"
#include "arm_cmse.h"
#include "core_cm33.h"

/* USER CODE END Includes */

/* Private typedef -----------------------------------------------------------*/
/* USER CODE BEGIN PTD */

/* USER CODE END PTD */

/* Private define ------------------------------------------------------------*/
/* USER CODE BEGIN PD */
/* USER CODE END PD */

/* Private macro -------------------------------------------------------------*/
/* USER CODE BEGIN PM */

/* USER CODE END PM */

/* Private variables ---------------------------------------------------------*/

/* USER CODE BEGIN PV */

/* USER CODE END PV */

/* Private function prototypes -----------------------------------------------*/
/* USER CODE BEGIN PFP */

/* USER CODE END PFP */

/* Private user code ---------------------------------------------------------*/
/* USER CODE BEGIN 0 */
//this function will raise secure fault by access secure area directly.
void RaiseSecureFault(void)
{
  //read secure SRAM address
  *(volatile uint32_t *)0x30000000UL = 0;
}

//secure fault generated by IDAU/SAU check */
void SecureFault_Callback(void)
{
  HAL_GPIO_WritePin(LED_RED_GPIO_Port, LED_RED_Pin, GPIO_PIN_SET);
  Error_Handler();
}

//secure error generated by GTZC check
void SecureError_Callback(void)
{
  HAL_GPIO_WritePin(LED_RED_GPIO_Port, LED_RED_Pin, GPIO_PIN_SET);
  Error_Handler();
}

/* USER CODE END 0 */

/**
  * @brief  The application entry point.
  * @retval int
  */

#define POX_INPUT_SIZE 1
#define POX_OUTPUT_SIZE 1

uint8_t pox_input[POX_INPUT_SIZE] = {0};
uint8_t pox_output[POX_OUTPUT_SIZE] = {0};

uint8_t sum = 10;

uint8_t read1() {
	return 10;
}

uint8_t read2() {
	return 15;
}

void sendline(char* s) {
	int i=0;
	while(s[i] != '\n') i++;
	SECURE_send((uint8_t*)s, (i+1));

}

static void test(uint8_t val) {
	SECURE_checkState(&sum, 1);
	uint8_t out;
	if(val == 0) out = read1();
	else out = read2();
	out += val;
	sum += out;
	pox_output[0] = sum;

	uint8_t msg[20] = {0};
	sprintf(msg, "PoX: %d\n", sum);
	SECURE_send(msg, 8);
	//sendline(msg);
	SECURE_setState(&sum, 1);
}

static void wrapper_test() {
	test(pox_input[0]);
}

//#define CRYPTO_HMAC_SHA256
//#define CRYPTO_ED25519
#define CRYPTO_ECC

#define SHA256_DIGEST_SIZE 32

#ifdef CRYPTO_HMAC_SHA256
#define TOKEN_SIZE SHA256_DIGEST_SIZE

#elif defined(CRYPTO_ECC)
#define TOKEN_SIZE 64

#elif defined(CRYPTO_ED25519)
#define EDSIGN_SIGNATURE_SIZE  64
#define TOKEN_SIZE EDSIGN_SIGNATURE_SIZE

#endif

void print_token(uint8_t *token, int size) {
	char hex[3]={0};
	SECURE_send("0x",2);
	for(int i=0; i<size; i++) {
		sprintf(hex, "%.2x", token[i]);
		SECURE_send(hex, 2);
	}
	SECURE_send("\n", 1);
}

uint8_t buffer[32];
unsigned numSigs;
static uint8_t *get_sphinc_sig() {
	uint8_t buff[30];
	//sendline("SPHINCSPHINC\n");
	unsigned n = 0;
	int rem = 17088-numSigs;
	if(rem > sizeof buffer) n = sizeof buffer;
	else n = rem;

	sprintf(buff, "SPHINCSPHINC n=%d\n", n);
	sendline(buff);

	numSigs += n;
	SECURE_recv(buffer,5);

	sprintf(buff, "%d\n", n);
	sendline(buff);
	return buffer;
}

void pox_wrapper() {
	if(0) {
		//sendline("Prv is active!\n");

		uint8_t buff[100] = {0};
		//uint8_t token[32] = {0};

		uint8_t req[100]={0};
		SECURE_recv(req, TOKEN_SIZE+9);

		//SECURE_send("Receive: \n", 10);
		sendline("RECV: \n");

		uint32_t f, c;
		uint8_t i;
		c = *(uint32_t*)(req);
		f = *(uint32_t*)(req+4);
		i = *(uint32_t*)(req+8);
		sprintf(buff, "%d, %d, %d\n", c, f, i);
		sendline(buff);
		//SECURE_send(buff, 20);

		uint8_t *token = (uint8_t*) (req+9);

		sprintf(buff, "get_sphinc_sig at: %p, wrapper_test at: %p\n", &get_sphinc_sig, &wrapper_test);
		//SECURE_send(buff, 30);
		sendline(buff);

		pox_call_t pc;
		pc.counter = c;
		pc.addr = f; // &wrapper_test;
		pox_input[0] = i;
		pc.input = pox_input;
		pc.input_size = 1;
		pc.output = pox_output;
		pc.output_size = 4;

		//sendline("SPHINCSTART\n");

		SECURE_pox(&pc, token);
		print_token(token, TOKEN_SIZE);
		print_token(pc.output, pc.output_size);
	} else {
		sendline("Unconditionally called PoX!\n");
		uint8_t token[32] = {0};
		pox_call_t pc;
		pc.counter = 12;
		pc.addr = &wrapper_test;
		pox_input[0] = 10;
		pc.input = pox_input;
		pc.input_size = 1;
		pc.output = pox_output;
		pc.output_size = 4;

		//sendline("SPHINCSTART\n");

		SECURE_pox(&pc, token);

	}
}


int main(void)
{
  /* USER CODE BEGIN 1 */
  /* USER CODE END 1 */

  /* MCU Configuration--------------------------------------------------------*/

  /* Reset of all peripherals, Initializes the Flash interface and the Systick. */
  HAL_Init();

  /* USER CODE BEGIN Init */

  /* USER CODE END Init */

  /* Initialize all configured peripherals */
   MX_GPIO_Init();

  /* USER CODE BEGIN SysInit */

  /* USER CODE END SysInit */

  /* Initialize all configured peripherals */
  /* USER CODE BEGIN 2 */
  //register error callbacks
  SECURE_RegisterCallback(SECURE_FAULT_CB_ID, (void *)SecureFault_Callback);
  SECURE_RegisterCallback(GTZC_ERROR_CB_ID, (void *)SecureError_Callback);
  /* USER CODE END 2 */

  uint8_t msg[40] = {0};
  int numIter = SECURE_avg(10, 20);

  /*for(int i=0; i<numIter; i++) {
	  sprintf(msg, "From NS World: %d/%d\n", i, numIter);
	  print_str(msg);
	  //SECURE_send(msg, sizeof(msg));
  }*/

  pox_wrapper();

  /* Infinite loop */
  /* USER CODE BEGIN WHILE */
  while (1)
  {
    /* USER CODE END WHILE */
    /* USER CODE BEGIN 3 */
  }
  /* USER CODE END 3 */
}

/* USER CODE BEGIN 4 */
/* USER CODE END 4 */

/**
  * @brief  This function is executed in case of error occurrence.
  * @retval None
  */
void Error_Handler(void)
{
  /* USER CODE BEGIN Error_Handler_Debug */
  /* User can add his own implementation to report the HAL error return state */
  __disable_irq();
  while (1)
  {
  }
  /* USER CODE END Error_Handler_Debug */
}

#ifdef  USE_FULL_ASSERT
/**
  * @brief  Reports the name of the source file and the source line number
  *         where the assert_param error has occurred.
  * @param  file: pointer to the source file name
  * @param  line: assert_param error line source number
  * @retval None
  */
void assert_failed(uint8_t *file, uint32_t line)
{
  /* USER CODE BEGIN 6 */
  /* User can add his own implementation to report the file name and line number,
     ex: printf("Wrong parameters value: file %s on line %d\r\n", file, line) */
  /* USER CODE END 6 */
}
#endif /* USE_FULL_ASSERT */
